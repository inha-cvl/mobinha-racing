VERSION ""

NS_ :

BS_:

BU_:

BO_ 528 RADAR1: 32 Vector__XXX
 SG_ CRC01 : 0|16@1+ (1,0) [0|65535] "" Vector__XXX
 SG_ ALV01 : 16|8@1+ (1,0) [0|255] "" Vector__XXX
 SG_ Mov1 : 29|1@1+ (1,0) [0|1] "" Vector__XXX
 SG_ Tag01 : 30|2@1+ (1,0) [0|3] "" Vector__XXX
 SG_ CLU01 : 32|8@1+ (1,0) [0|255] "" Vector__XXX
 SG_ Long01 : 40|15@1+ (0.01,0) [0|327.67] "" Vector__XXX
 SG_ Valid01 : 56|14@1+ (1,0) [0|0] "" Vector__XXX
 SG_ Lat01 : 72|13@1+ (0.01,0) [-81.92|81.91] "" Vector__XXX
 SG_ Speed01 : 85|3@1+ (0.025,0) [-102.4|102.3] "" Vector__XXX
 SG_ TrustV01 : 88|8@1+ (1,0) [0|7] "" Vector__XXX
 SG_ Height01 : 96|10@1+ (0.1,7.3) [-5.5|20] "" Vector__XXX
 SG_ SNR01 : 106|6@1+ (0.1,0) [0|102.3] "" Vector__XXX
 SG_ Attr01 : 112|13@1+ (1,0) [0|63] "" Vector__XXX
 SG_ AmbigSpd01 : 125|3@1+ (0.025,0) [-102.4|102.3] "" Vector__XXX
 SG_ TrustA01 : 157|1@1+ (1,0) [0|7] "" Vector__XXX
 SG_ NewSignal_0016 : 158|2@1+ (1,0) [0|1] "" Vector__XXX
 SG_ NewSignal_0017 : 160|8@1+ (1,0) [0|0] "" Vector__XXX
 SG_ NewSignal_0018 : 168|15@1+ (1,0) [0|0] "" Vector__XXX
 SG_ NewSignal_0019 : 183|1@1+ (1,0) [0|0] "" Vector__XXX
 SG_ NewSignal_0020 : 184|14@1+ (1,0) [0|0] "" Vector__XXX
 SG_ NewSignal_0021 : 200|13@1+ (1,0) [0|0] "" Vector__XXX
 SG_ NewSignal_0022 : 213|3@1+ (1,0) [0|0] "" Vector__XXX
 SG_ NewSignal_0023 : 216|8@1+ (1,0) [0|0] "" Vector__XXX
 SG_ NewSignal_0024 : 224|10@1+ (1,0) [0|0] "" Vector__XXX
 SG_ NewSignal_0025 : 234|6@1+ (1,0) [0|0] "" Vector__XXX
 SG_ NewSignal_0026 : 240|13@1+ (1,0) [0|0] "" Vector__XXX
 SG_ NewSignal_0027 : 253|3@1+ (1,0) [0|0] "" Vector__XXX

BA_DEF_  "BusType" STRING ;
BA_DEF_ BO_  "VFrameFormat" ENUM  "StandardCAN","ExtendedCAN","reserved","reserved","reserved","reserved","reserved","reserved","reserved","reserved","reserved","reserved","reserved","reserved","StandardCAN_FD","ExtendedCAN_FD";
BA_DEF_DEF_  "BusType" "";
BA_DEF_DEF_  "VFrameFormat" "StandardCAN";
BA_ "BusType" "CAN FD";
BA_ "VFrameFormat" BO_ 528 14;
